## west.yml
```yaml
manifest:
  remotes:
    - name: zephyrproject-rtos
      url-base: https://github.com/zephyrproject-rtos
    - name: adigie
      url-base: https://github.com/adigie
  projects:
    - name: zephyr
      remote: zephyrproject-rtos
      revision: v4.3.0
      import:
        name-allowlist:
          - cmsis_6
    - name: test-lib
      remote: adigie
      repo-path: test-lib
      revision: main
    - name: test-bin
      remote: adigie
      repo-path: test-bin
      revision: main
```
